## modules/fleet-mesh/firmware/main/Kconfig.projbuild
```kconfig
menu "Fleet mesh"

config FLEET_TIME_SERVER
    string "SNTP server"
    default "162.159.200.1"
    help
        Hostname or numeric address used to establish UTC before this node
        applies commands or creates signed receipts.

endmenu
```

## modules/fleet-mesh/firmware/sdkconfig.defaults
```kconfig
CONFIG_IDF_TARGET="esp32s3"
CONFIG_ESPTOOLPY_FLASHSIZE_4MB=y
CONFIG_PARTITION_TABLE_CUSTOM=y
CONFIG_PARTITION_TABLE_CUSTOM_FILENAME="partitions.csv"
CONFIG_PARTITION_TABLE_OFFSET=0x8000
CONFIG_ETH_ENABLED=y
CONFIG_ETH_USE_OPENETH=y
CONFIG_HTTPD_MAX_REQ_HDR_LEN=1024
CONFIG_HTTPD_MAX_URI_LEN=128
CONFIG_LWIP_DHCP_DOES_ARP_CHECK=n
CONFIG_MBEDTLS_BASE64_C=y
CONFIG_MBEDTLS_GCM_C=y
CONFIG_MBEDTLS_SHA256_C=y
CONFIG_MBEDTLS_HARDWARE_AES=n
CONFIG_COMPILER_OPTIMIZATION_SIZE=y
CONFIG_ESP_MAIN_TASK_STACK_SIZE=16384
```
